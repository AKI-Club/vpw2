/* Virtual Pro-Wrestling 2 linker script
 * generated by n64split v0.4a - N64 ROM splitter */

OUTPUT_ARCH (mips)

/*============================================================================*/
/*
 * Some fun defines that mild would normally handle.
 * Sourced from the Super Mario 64 linker file:
 * https://github.com/n64decomp/sm64/blob/master/sm64.ld
 */

#define BEGIN_SEG(name, addr) \
	_##name##SegmentStart = ADDR(.name); \
	_##name##SegmentRomStart = __romPos; \
	.name addr : AT(__romPos)

#define END_SEG(name) \
	_##name##SegmentEnd = ADDR(.name) + SIZEOF(.name); \
	_##name##SegmentRomEnd = __romPos + SIZEOF(.name); \
	__romPos += SIZEOF(.name);

#define BEGIN_NOLOAD(name) \
	_##name##SegmentNoloadStart = ADDR(.name.noload); \
	.name.noload (NOLOAD) :

#define END_NOLOAD(name) \
	_##name##SegmentNoloadEnd = ADDR(.name.noload) + SIZEOF(.name.noload);

/*============================================================================*/
SECTIONS
{
	__romPos = 0;

	/* previously in undefined_syms.txt */
	/* ----- [hardware registers] ----- */
	OS_VI_NTSC_LAN1 = 2;
	OS_VI_PAL_LAN1 = 16;
	
	SP_MEM_ADDR_REG = 0xA4040000;
	SP_DRAM_ADDR_REG = 0xA4040004;
	SP_RD_LEN_REG = 0xA4040008;
	SP_WR_LEN_REG = 0xA404000C;
	SP_STATUS_REG = 0xA4040010;
	SP_PC_REG = 0xA4080000;
	
	DPC_REG_BASE = 0xA4100000;
	DPC_START_REG = 0xA4100000;
	DPC_END_REG = 0xA4100004;
	DPC_CURRENT_REG = 0xA4100008;
	DPC_STATUS_REG = 0xA410000C;
	DPC_CLOCK_REG = 0xA4100010;
	DPC_BUFBUSY_REG = 0xA4100014;
	DPC_PIPEBUSY_REG = 0xA4100018;
	DPC_TMEM_REG = 0xA410001C;
	
	MI_INIT_MODE_REG = 0xA4300000;
	MI_MODE_REG = MI_INIT_MODE_REG;
	MI_VERSION_REG = 0xA4300004;
	MI_INTR_REG = 0xA4300008;
	MI_INTR_MASK_REG = 0xA430000C;
	
	VI_STATUS_REG = 0xA4400000;
	VI_CONTROL_REG = 0xA4400000;
	VI_ORIGIN_REG = 0xA4400004;
	VI_DRAM_ADDR_REG = 0xA4400004;
	VI_WIDTH_REG = 0xA4400008;
	VI_H_WIDTH_REG = 0xA4400008;
	VI_INTR_REG = 0xA440000C;
	VI_V_INTER_REG = 0xA440000C;
	VI_CURRENT_REG = 0xA4400010;
	VI_V_CURRENT_LINE_REG = 0xA4400010;
	VI_BURST_REG = 0xA4400014;
	VI_TIMING_REG = 0xA4400014;
	VI_V_SYNC_REG = 0xA4400018;
	VI_H_SYNC_REG = 0xA440001C;
	VI_LEAP_REG = 0xA4400020;
	VI_H_SYNC_LEAP_REG = 0xA4400020;
	VI_H_START_REG = 0xA4400024;
	VI_H_VIDEO_REG = 0xA4400024;
	VI_V_START_REG = 0xA4400028;
	VI_V_VIDEO_REG = 0xA4400028;
	VI_V_BURST_REG = 0xA440002C;
	VI_X_SCALE_REG = 0xA4400030;
	VI_Y_SCALE_REG = 0xA4400034;
	
	AI_LEN_REG = 0xA4500004;
	AI_CONTROL_REG = 0xA4500008;
	AI_STATUS_REG = 0xA450000C;
	AI_DACRATE_REG = 0xA4500010;
	AI_BITRATE_REG = 0xA4500014;
	
	PI_DRAM_ADDR_REG = 0xA4600000;
	PI_CART_ADDR_REG = 0xA4600004;
	
	PI_RD_LEN_REG = 0xA4600008;
	PI_WR_LEN_REG = 0xA460000C;
	PI_STATUS_REG = 0xA4600010;
	PI_BSD_DOM1_LAT_REG = 0xA4600014;
	PI_DOMAIN1_REG = 0xA4600014;
	PI_BSD_DOM1_PWD_REG = 0xA4600018;
	PI_BSD_DOM1_PGS_REG = 0xA460001C;
	PI_BSD_DOM1_RLS_REG = 0xA4600020;
	PI_BSD_DOM2_LAT_REG = 0xA4600024;
	PI_DOMAIN2_REG = 0xA4600024;
	PI_BSD_DOM2_PWD_REG = 0xA4600028;
	PI_BSD_DOM2_PGS_REG = 0xA460002C;
	PI_BSD_DOM2_RLS_REG = 0xA4600030;
	
	SI_DRAM_ADDR_REG = 0xA4800000;
	SI_PIF_ADDR_RD64B_REG = 0xA4800004;
	SI_PIF_ADDR_WR64B_REG = 0xA4800010;
	SI_STATUS_REG = 0xA4800018;
	
	ASIC_STATUS = 0xA5000508;
	ASIC_BM_STATUS = 0xA5000510;
	
	/* these are probably part of the bootcode */
	osTvType = 0x80000300;
	osRomBase = 0x80000308;
	osResetType = 0x8000030C;
	osAppNMIBuffer = 0x8000031C;

	/* -- header and boot --------------------------------------------------- */
	/*.boot 0x0 : AT(0x0) {*/
	BEGIN_SEG(boot,0) {
		BUILD_DIR/vpw2_z.o(.header);
		BUILD_DIR/vpw2_z.o(.boot);
	}
	END_SEG(boot)

	/* -- main/global segment ----------------------------------------------- */
	/* 0x80000400 001000-03A730 [39730] */
	/*.textmain 0x80000400 : AT(0x001000) {*/
	BEGIN_SEG(textmain, 0x80000400) {
		BUILD_DIR/src/textmain.o(.text);
		BUILD_DIR/vpw2_z.o(.othertextmain);
	}
	END_SEG(textmain)

	BEGIN_SEG(basedl, 0x8004B2A0) {
		* (.basedl)
	}
	END_SEG(basedl)

	BEGIN_NOLOAD(bss_main) {
		* (.bss_main)
	}
	END_NOLOAD(bss_main)

	/* -- seg0: menus 1 ----------------------------------------------------- */
	/*.seg00 0x800E6AF0 : AT(0x04BF40) {*/
	BEGIN_SEG(seg00, 0x800E6AF0){
		* (.text00);
	}
	END_SEG(seg00)

	BEGIN_NOLOAD(bss_00) {
		* (.bss_00)
	}
	END_NOLOAD(bss_00)

	/* -- seg1: cutscenes --------------------------------------------------- */
	/*.seg01 0x80119450 : AT(0x071A90){*/
	BEGIN_SEG(seg01, 0x80119450){
		* (.text01);
	}
	END_SEG(seg01)

	BEGIN_NOLOAD(bss_01) {
		* (.bss_01)
	}
	END_NOLOAD(bss_01)

	/* -- seg2: menus 2 ----------------------------------------------------- */
	/*.seg02 0x80119450 : AT(0x084710){*/
	BEGIN_SEG(seg02, 0x80119450) {
		* (.text02);
	}
	END_SEG(seg02)

	BEGIN_NOLOAD(bss_02) {
		* (.bss_02)
	}
	END_NOLOAD(bss_02)

	BEGIN_NOLOAD(bss_malloc) {
		* (.bss_malloc)
	}
	END_NOLOAD(bss_malloc)

	/* -- seg3: gameplay ---------------------------------------------------- */
	/*.seg03 0x800E6AF0 : AT(0x0E11A0){*/
	BEGIN_SEG(seg03, 0x800E6AF0) {
		* (.text03);
	}
	END_SEG(seg03)

	BEGIN_NOLOAD(bss_03) {
		* (.bss_03)
	}
	END_NOLOAD(bss_03)

	/* -- data below this line ---------------------------------------------- */

	/* -- filetable stuff --------------------------------------------------- */
	_filetableSegmentRomStart = __romPos;
	.filetable : AT(__romPos) {
		* (.filetable);
	}
	__romPos += SIZEOF(.filetable);

	_fileindexSegmentRomStart = __romPos;
	.fileindex : AT(__romPos) {
		* (.fileindex);
	}
	__romPos += SIZEOF(.fileindex);

	/* not sure about this segment */
	.somejunk : AT(__romPos) {
		* (.somejunk);
	}
	__romPos += SIZEOF(.somejunk);

	/* -- soundtable stuff -------------------------------------------------- */
	_soundtable1PointerRomStart = __romPos;
	.soundtbl1_ptr : AT(__romPos){
		* (.soundtbl1_ptr);
	}
	__romPos += SIZEOF(.soundtbl1_ptr);

	_soundtable1WaveBankRomStart = __romPos;
	.soundtbl1_wbk : AT(__romPos){
		* (.soundtbl1_wbk);
	}
	__romPos += SIZEOF(.soundtbl1_wbk);

	_soundtable1TableRomStart = __romPos;
	.soundtbl1_tbl : AT(__romPos){
		* (.soundtbl1_tbl);
	}
	__romPos += SIZEOF(.soundtbl1_tbl);

	_soundtable2PointerRomStart = __romPos;
	.soundtbl2_ptr : AT(__romPos){
		* (.soundtbl2_ptr);
	}
	__romPos += SIZEOF(.soundtbl2_ptr);

	_soundtable2WaveBankRomStart = __romPos;
	.soundtbl2_wbk : AT(__romPos){
		* (.soundtbl2_wbk);
	}
	__romPos += SIZEOF(.soundtbl2_wbk);

	_soundtable2TableRomStart = __romPos;
	.soundtbl2_tbl : AT(__romPos){
		* (.soundtbl2_tbl);
	}
	__romPos += SIZEOF(.soundtbl2_tbl);

	_soundtable3PointerRomStart = __romPos;
	.soundtbl3_ptr : AT(__romPos){
		* (.soundtbl3_ptr);
	}
	__romPos += SIZEOF(.soundtbl3_ptr);

	_soundtable3WaveBankRomStart = __romPos;
	.soundtbl3_wbk : AT(__romPos){
		* (.soundtbl3_wbk);
	}
	__romPos += SIZEOF(.soundtbl3_wbk);

	_soundtable3TableRomStart = __romPos;
	.soundtbl3_tbl : AT(__romPos){
		* (.soundtbl3_tbl);
	}
	__romPos += SIZEOF(.soundtbl3_tbl);

	_soundtable4PointerRomStart = __romPos;
	.soundtbl4_ptr : AT(__romPos){
		* (.soundtbl4_ptr);
	}
	__romPos += SIZEOF(.soundtbl4_ptr);

	_soundtable4WaveBankRomStart = __romPos;
	.soundtbl4_wbk : AT(__romPos){
		* (.soundtbl4_wbk);
	}
	__romPos += SIZEOF(.soundtbl4_wbk);

	_soundtable4TableRomStart = __romPos;
	.soundtbl4_tbl : AT(__romPos){
		* (.soundtbl4_tbl);
	}
	__romPos += SIZEOF(.soundtbl4_tbl);

	_soundtable5PointerRomStart = __romPos;
	.soundtbl5_ptr : AT(__romPos){
		* (.soundtbl5_ptr);
	}
	__romPos += SIZEOF(.soundtbl5_ptr);

	_soundtable5WaveBankRomStart = __romPos;
	.soundtbl5_wbk : AT(__romPos){
		* (.soundtbl5_wbk);
	}
	__romPos += SIZEOF(.soundtbl5_wbk);

	_soundtable5TableRomStart = __romPos;
	.soundtbl5_tbl : AT(__romPos){
		* (.soundtbl5_tbl);
	}
	__romPos += SIZEOF(.soundtbl5_tbl);

	_soundtable6PointerRomStart = __romPos;
	.soundtbl6_ptr : AT(__romPos){
		* (.soundtbl6_ptr);
	}
	__romPos += SIZEOF(.soundtbl6_ptr);

	_soundtable6WaveBankRomStart = __romPos;
	.soundtbl6_wbk : AT(__romPos){
		* (.soundtbl6_wbk);
	}
	__romPos += SIZEOF(.soundtbl6_wbk);

	_soundtable6TableRomStart = __romPos;
	.soundtbl6_tbl : AT(__romPos){
		* (.soundtbl6_tbl);
	}
	__romPos += SIZEOF(.soundtbl6_tbl);

	_soundtable7PointerRomStart = __romPos;
	.soundtbl7_ptr : AT(__romPos){
		* (.soundtbl7_ptr);
	}
	__romPos += SIZEOF(.soundtbl7_ptr);

	_soundtable7WaveBankRomStart = __romPos;
	.soundtbl7_wbk : AT(__romPos){
		* (.soundtbl7_wbk);
	}
	__romPos += SIZEOF(.soundtbl7_wbk);

	_soundtable7TableRomStart = __romPos;
	.soundtbl7_tbl : AT(__romPos){
		* (.soundtbl7_tbl);
	}
	__romPos += SIZEOF(.soundtbl7_tbl);

	_soundtable8PointerRomStart = __romPos;
	.soundtbl8_ptr : AT(__romPos){
		* (.soundtbl8_ptr);
	}
	__romPos += SIZEOF(.soundtbl8_ptr);

	_soundtable8WaveBankRomStart = __romPos;
	.soundtbl8_wbk : AT(__romPos){
		* (.soundtbl8_wbk);
	}
	__romPos += SIZEOF(.soundtbl8_wbk);

	/DISCARD/ : {
		* (.MIPS.abiflags);
		* (.options);
		* (.gnu.attributes);
		* (.pdr);
		* (.mdebug);
		* (.gptab.bss);
		* (.gptab.data);
		* (.reginfo);
	}
}

